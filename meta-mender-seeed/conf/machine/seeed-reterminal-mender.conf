## meta-mender-seeed/conf/machine/seeed-reterminal-mender.conf
```bitbake
require conf/machine/raspberrypi4-64.conf

RPI_KERNEL_DEVICETREE_OVERLAYS:append = " overlays/reTerminal.dtbo overlays/i2c3.dtbo"

KERNEL_MODULE_AUTOLOAD:rpi += "i2c-dev"

ENABLE_I2C = "1"
ENABLE_UART = "1"

# mender conf
RPI_USE_U_BOOT = "1"
MENDER_BOOT_PART_SIZE_MB = "100"
MENDER_STORAGE_TOTAL_SIZE_MB = "2048"
MENDER_FEATURES_ENABLE:append = " mender-uboot mender-image-sd"
MENDER_FEATURES_DISABLE:append = " mender-grub mender-image-uefi"

PREFERRED_VERSION_linux-raspberrypi ?= "6.1.%"

MACHINE_ESSENTIAL_EXTRA_RDEPENDS += " \
    kernel-image \
    kernel-devicetree \
	seeed-linux-dtoverlays \
"
```
